## conf/distro/hipos.conf
```bitbake
# HIPOS (HydraIP Operating System)

require conf/distro/poky.conf

DISTRO = "hipos"
DISTRO_NAME = "HIPOS (Poky based HydraIP Operating System)"
DISTRO_VERSION = "v2023.06"
DISTRO_CODENAME = "mickledore"

DISTRO_FEED_PREFIX = "hipos"
DISTRO_FEED_URI = "http://package-feed.dresearch-fe.de/hipos/yocto-4.2-mickledore"

SDKPATHINSTALL = "/usr/local/${SDK_NAME_PREFIX}-${SDK_ARCH}/${TUNE_PKGARCH}"

MAINTAINER = "DFE"

REMOVE_VULKAN_FEATURE = "vulkan"
REMOVE_VULKAN_FEATURE:mx8-nxp-bsp = ""
POKY_DEFAULT_DISTRO_FEATURES:remove      = "wayland ${REMOVE_VULKAN_FEATURE}"
POKY_DEFAULT_DISTRO_FEATURES:append:mx8-nxp-bsp  = " jailhouse"

INHERIT:remove = "uninative"

PREFERRED_PROVIDER_virtual/bootloader:mx8-nxp-bsp = "u-boot-imx-tq"
PREFERRED_PROVIDER_virtual/kernel:mx8-nxp-bsp = "linux-imx"

PREFERRED_VERSION_linux-libc-headers:mx8-nxp-bsp ?= "5.10"

PREFERRED_PROVIDER_opencl-headers:imxgpu = "imx-gpu-viv"
PREFERRED_PROVIDER_opencl-icd-loader:imxgpu = "imx-gpu-viv"

PREFERRED_VERSION_gstreamer1.0-plugins-base:mx8-nxp-bsp = "1.20.3.imx"
PREFERRED_VERSION_gstreamer1.0-plugins-bad:mx8-nxp-bsp  = "1.20.3.imx"
PREFERRED_VERSION_gstreamer1.0-plugins-good:mx8-nxp-bsp = "1.20.3.imx"
PREFERRED_VERSION_gstreamer1.0-plugins-good-qt:mx8-nxp-bsp = "1.20.3.imx"
PREFERRED_VERSION_gstreamer1.0:mx8-nxp-bsp              = "1.20.3.imx"
PREFERRED_VERSION_gstreamer1.0-libav:mx8-nxp-bsp        = "1.20.5"

PREFERRED_VERSION_opengl-es-cts     = "3.2.6.1"
PREFERRED_VERSION_opengl-es-cts:mx6-nxp-bsp = "3.2.4.0"
PREFERRED_VERSION_opengl-es-cts:mx7-nxp-bsp = "3.2.4.0"

# Build errors with nginx 1.23.4
PREFERRED_VERSION_nginx = "1.21.1"

# Use systemd as default init manager
VIRTUAL-RUNTIME_init_manager = "systemd"
PREFERRED_PROVIDER_udev = "systemd"
PREFERRED_PROVIDER_udev-utils = "systemd"
DISTRO_FEATURES_BACKFILL_CONSIDERED = "sysvinit"
POKY_DEFAULT_DISTRO_FEATURES += " systemd"

# Remove conflicting backends
DISTRO_FEATURES:remove = "directfb x11 "
DISTRO_FEATURES:append = " pam systemd"
# Remove nfs HYP-29628
DISTRO_FEATURES:remove = "nfs"
DISTRO_FEATURES:append:mx8-nxp-bsp = " wayland"
# Remove nfc and bluetooth HYP-31307
DISTRO_FEATURES:remove = "bluetooth nfc"

LICENSE_FLAGS_ACCEPTED += "commercial"

# Default hash policy for distro
BB_SIGNATURE_HANDLER = "OEBasicHash"

EXTRA_IMAGE_FEATURES += "ssh-server-openssh"
```

## conf/machine/hikirk.conf
```bitbake
require conf/machine/include/kirkwood.inc

IMAGE_FSTYPES = "tar.bz2 squashfs ext4"
MACHINE_FEATURES = "kernel26 apm usbgadget usbhost vfat ext2 ethernet"

UBOOT_MACHINE = "hikirk_config"
UBOOT_ARCH = "arm"

KERNEL_DEVICETREE = "kirkwood-hikirk.dtb"

# Machine specific preferences

PREFERRED_PROVIDER_virtual/bootloader 	 = "u-boot-kirkwood"
PREFERRED_PROVIDER_virtual/kernel 	 = "linux-yocto-hikirk"
EXTRA_IMAGEDEPENDS 			+= "virtual/bootloader virtual/kernel"
```

## conf/machine/himx.conf
```bitbake
# This is just a machine alias for himx0280 for compatibility purposes.
# DO NOT USE ANY LONGER!

MACHINEOVERRIDES = "himx0280"
include conf/machine/himx0280.conf
```

## conf/machine/himx0280.conf
```bitbake
#@TYPE: Machine
#@NAME: DResearch HydraIP device based on i.MX6 (IP Camera)
#@SOC: i.MX6Q
#@DESCRIPTION: Machine configuration for DResearch HydraIP device based on i.MX6 (IP Camera)

include conf/machine/include/imx-base.inc
include conf/machine/include/tune-cortexa9.inc

SOC_FAMILY = "mx6:mx6q"

KERNEL_DEVICETREE = "imx6q-himx0280.dtb"

KERNEL_IMAGETYPE = "uImage"

PREFERRED_PROVIDER_u-boot = "u-boot-himx0280"
PREFERRED_PROVIDER_virtual/bootloader = "u-boot-himx0280"
PREFERRED_PROVIDER_virtual/kernel = "linux-imx"

UBOOT_MACHINE = "dres0280_rev_a_config"

SERIAL_CONSOLE = "115200 ttymxc1"

MACHINE_FEATURES += " pci"

DEFAULTTUNE_himx0280 = "cortexa9thf-neon"
```

## conf/machine/himx0294.conf
```bitbake
#@TYPE: Machine
#@NAME: DResearch HydraIP device based on i.MX6 (Smart Terminal)
#@SOC: i.MX6Q
#@DESCRIPTION: Machine configuration for DResearch HydraIP device based on Freescale i.MX6 (Smart Terminal)

MACHINEOVERRIDES =. "mx6q:mx6dl:"

include conf/machine/include/imx-base.inc
include conf/machine/include/tune-cortexa9.inc
include conf/machine/include/arm/armv7a/tune-cortexa9.inc

# To be able to use NXP BSP only recipes. See meta-freescale/classes/use-imx-headers.bbclass
IMX_DEFAULT_BSP = "nxp"

SERIAL_CONSOLES = "115200;ttymxc1"

SOC_FAMILY = "mx6dl:mx6q"

KERNEL_DEVICETREE = " \
	imx6q-himx0294-imoc.dtb     \
	imx6q-himx0294-imoc-2.dtb   \
	imx6q-himx0294-ivap.dtb     \
	imx6q-himx0294-dvmon.dtb    \
	imx6q-himx0294-dvmon-2.dtb  \
	imx6q-himx0294-dvrec.dtb    \
	imx6qp-himx0294-dvrec.dtb   \
	imx6ull-himx0294-impec.dtb \
	imx6ull-himx0294-impec-2.dtb \
"

KERNEL_IMAGETYPES = "uImage zImage"

UBOOT_SUFFIX = "imx"
UBOOT_BINARY = "u-boot-dtb.${UBOOT_SUFFIX}"
PREFERRED_PROVIDER_u-boot = "u-boot"
PREFERRED_PROVIDER_virtual/bootloader = "u-boot"
PREFERRED_PROVIDER_virtual/kernel ?= "linux-boundary"

UBOOT_CONFIG ??= "himx0294-imoc himx0294-ivap himx0294-ivqp himx0294-dvmon himx0294-impec"
UBOOT_CONFIG[himx0294-imoc] = "himx0294_imoc_config"
UBOOT_CONFIG[himx0294-ivap] = "himx0294_ivap_config"
UBOOT_CONFIG[himx0294-ivqp] = "himx0294_ivqp_config"
UBOOT_CONFIG[himx0294-dvmon] = "himx0294_dvmon_config"
UBOOT_CONFIG[himx0294-impec] = "himx0294_impec_config"

SERIAL_CONSOLE = "115200 ttymxc1"

MACHINE_FEATURES += " pci wifi bluetooth"
```

## conf/machine/himx0438.conf
```bitbake
include conf/machine/imx8mmevk.conf

KERNEL_DEVICETREE = " \
	freescale/fsl-imx8mm-himx0438-ipcam.dtb \
"

# Remove qca6174 from MACHINE_FEATURES to avoid error during do_rootfs:
# Collected errors:
# * check_data_file_clashes: Package firmware-qca9377 wants to install file hydraip-prodimage/1.0-r0/rootfs/etc/bluetooth/firmware.conf
#        But that file is already provided by package  * firmware-qca6174
MACHINE_FEATURES_remove = " qca6174"

# Use imx version of gstreamer1.0-plugins, otherwise package 'imx-gst1.0-plugin'
# cannot be compiled. Package 'imx-gst1.0-plugin' provides gstreamer1.0 plugins
# 'vpu' and 'imxvideoconvert'.
PREFERRED_VERSION_gstreamer1.0              = "1.14.imx"
PREFERRED_VERSION_gstreamer1.0-plugins-base = "1.14.imx"
PREFERRED_VERSION_gstreamer1.0-plugins-good = "1.14.imx"
PREFERRED_VERSION_gstreamer1.0-plugins-bad  = "1.14.imx"
```

## recipes-bsp/u-boot/u-boot-2021.01/himx0294/himx0294_ivqp_defconfig
```kconfig
CONFIG_ARM=y
CONFIG_ARCH_MX6=y
CONFIG_SYS_TEXT_BASE=0x17800000
CONFIG_TARGET_HIMX0294=y
CONFIG_ENV_SIZE=0x2000
CONFIG_ENV_OFFSET=0xFC000
CONFIG_ENV_OFFSET_REDUND=0xFE000
CONFIG_NR_DRAM_BANKS=1
CONFIG_DISPLAY_CPUINFO=y
CONFIG_DISPLAY_BOARDINFO=y
CONFIG_MMC=y
CONFIG_DEFAULT_FDT_FILE="/boot/imx6q-himx0294-ivap.dtb"
CONFIG_CMD_HDMIDETECT=y
CONFIG_SYS_EXTRA_OPTIONS="IMX_CONFIG=board/freescale/himx0294/mx6qp.cfg,MX6Q,BOARD_IS_HIMX_IVAP"
CONFIG_BOOTDELAY=0
CONFIG_SYS_CONSOLE_OVERWRITE_ROUTINE=y
CONFIG_SUPPORT_RAW_INITRD=y
CONFIG_BOARD_EARLY_INIT_F=y
CONFIG_HUSH_PARSER=y
CONFIG_CMD_BOOTZ=y
CONFIG_CMD_MEMTEST=y
CONFIG_SYS_MEMTEST_START=0x10000000
CONFIG_SYS_MEMTEST_END=0x10010000
CONFIG_SYS_ALT_MEMTEST=y
# CONFIG_CMD_FLASH is not set
CONFIG_CMD_GPIO=y
CONFIG_CMD_I2C=y
CONFIG_CMD_MMC=y
CONFIG_CMD_SATA=y
CONFIG_CMD_SF=y
CONFIG_CMD_USB=y
CONFIG_CMD_USB_MASS_STORAGE=y
CONFIG_CMD_DHCP=y
CONFIG_CMD_MII=y
CONFIG_CMD_PING=y
CONFIG_CMD_BMP=y
CONFIG_CMD_CACHE=y
CONFIG_CMD_TIME=y
CONFIG_CMD_EXT2=y
CONFIG_CMD_EXT4=y
CONFIG_CMD_EXT4_WRITE=y
CONFIG_CMD_FAT=y
CONFIG_CMD_FS_GENERIC=y
# CONFIG_ENV_IS_IN_SPI_FLASH is not set
CONFIG_DWC_AHSATA=y
# CONFIG_USB_FUNCTION_FASTBOOT is not set
# CONFIG_FASTBOOT_BUF_ADDR is not set
CONFIG_FSL_USDHC=y
CONFIG_SPI_FLASH=y
CONFIG_SF_DEFAULT_MODE=0
CONFIG_SF_DEFAULT_SPEED=25000000
CONFIG_SPI_FLASH_MACRONIX=y
CONFIG_PHYLIB=y
CONFIG_PHY_MICREL=y
CONFIG_PHY_MICREL_KSZ9021=y
# CONFIG_NETDEVICES is not set
CONFIG_SPI=y
CONFIG_MXC_SPI=y
CONFIG_MXC_OCOTP=y
CONFIG_USB=y
CONFIG_USB_STORAGE=y
# CONFIG_USB_KEYBOARD is not set
CONFIG_SYS_USB_EVENT_POLL_VIA_CONTROL_EP=y
CONFIG_USB_GADGET=y
CONFIG_USB_GADGET_DOWNLOAD=y
# CONFIG_USB_GADGET_MANUFACTURER is not set
# CONFIG_USB_GADGET_VENDOR_NUM is not set
# CONFIG_USB_GADGET_PRODUCT_NUM is not set
CONFIG_CI_UDC=y
CONFIG_USB_ETHER=y
CONFIG_USB_ETH_CDC=y
CONFIG_VIDEO=y
CONFIG_CFB_CONSOLE=y
CONFIG_VGA_AS_SINGLE_DEVICE=y
CONFIG_SYS_CONSOLE_BG_COL=0x00
CONFIG_SYS_CONSOLE_FG_COL=0xa0
CONFIG_CONSOLE_MUX=y
CONFIG_SYS_CONSOLE_IS_IN_ENV=y
CONFIG_OF_LIBFDT=y
CONFIG_FS_FAT=y
CONFIG_SATA=y
CONFIG_CMD_SAVEENV=y
CONFIG_ENV_IS_IN_MMC=y
CONFIG_SYS_REDUNDAND_ENVIRONMENT=y
CONFIG_AUTOBOOT_KEYED=y
CONFIG_AUTOBOOT_PROMPT="Press . to abort autoboot in %d seconds\n"
CONFIG_AUTOBOOT_STOP_STR="."
CONFIG_ZERO_BOOTDELAY_CHECK=y
CONFIG_DM=y
CONFIG_DM_VIDEO=y
CONFIG_DM_GPIO=y
CONFIG_OF_CONTROL=y
CONFIG_DEFAULT_DEVICE_TREE="imx6q-nitrogen6x"
```

## recipes-bsp/u-boot/u-boot-2023.01/himx0294/Kconfig
```kconfig
if TARGET_HIMX0294

choice
	prompt "Board variant"

config BOARD_IS_HIMX_DVMON
	bool "DVMON"

config BOARD_IS_HIMX_IMOC
	bool "IMOC"

config BOARD_IS_HIMX_IPCAM
	bool "IPCAM"

config BOARD_IS_HIMX_IVAP
	bool "IVAP"

endchoice

config SYS_BOARD
	default "himx0294"

config SYS_VENDOR
	default "freescale"

config SYS_SOC
	default "mx6"

config SYS_CONFIG_NAME
	default "himx0294"

endif
```

## recipes-bsp/u-boot/u-boot-2023.01/himx0294/himx0294_impec_defconfig
```kconfig
CONFIG_ARM=y
CONFIG_ARCH_MX6=y
CONFIG_MX6ULL=y
CONFIG_SYS_TEXT_BASE=0x87800000
CONFIG_SYS_MALLOC_LEN=0xa00000
CONFIG_SYS_RELOC_GD_ENV_ADDR=y
CONFIG_TARGET_HIMXULL=y
CONFIG_ENV_SIZE=0x2000
CONFIG_ENV_OFFSET=0xFC000
CONFIG_ENV_OFFSET_REDUND=0xFE000
CONFIG_NR_DRAM_BANKS=1
CONFIG_DEFAULT_FDT_FILE="/boot/imx6ull-himx0294-impec-2.dtb"
CONFIG_DEFAULT_DEVICE_TREE="imx6ull-14x14-evk"
CONFIG_IMX_CONFIG="board/freescale/himx0432/imximage-1GiB.cfg"
CONFIG_SYS_EXTRA_OPTIONS=""
CONFIG_SUPPORT_RAW_INITRD=y
CONFIG_BOARD_EARLY_INIT_F=y
CONFIG_HUSH_PARSER=y
CONFIG_CMD_BOOTZ=y
CONFIG_CMD_MEMTEST=y
CONFIG_SYS_MEMTEST_START=0x80000000
CONFIG_SYS_MEMTEST_END=0x88000000
CONFIG_CMD_GPIO=y
CONFIG_CMD_I2C=y
CONFIG_CMD_MMC=y
CONFIG_CMD_SF=y
CONFIG_CMD_DHCP=y
CONFIG_CMD_PING=y
CONFIG_CMD_CACHE=y
CONFIG_CMD_EXT2=y
CONFIG_CMD_EXT4=y
CONFIG_CMD_EXT4_WRITE=y
CONFIG_CMD_FAT=y
CONFIG_CMD_FS_GENERIC=y
CONFIG_OF_CONTROL=y
CONFIG_ENV_IS_IN_MMC=y
CONFIG_SYS_REDUNDAND_ENVIRONMENT=y
CONFIG_ENV_VARS_UBOOT_RUNTIME_CONFIG=y
CONFIG_DM_GPIO=y
CONFIG_DM_74X164=y
#CONFIG_DM_I2C=y
CONFIG_DM_MMC=y
CONFIG_FSL_USDHC=y
CONFIG_DM_SPI_FLASH=y
CONFIG_SPI_FLASH=y
CONFIG_SF_DEFAULT_MODE=0
CONFIG_SF_DEFAULT_SPEED=40000000
CONFIG_SPI_FLASH_BAR=y
CONFIG_SPI_FLASH_STMICRO=y
CONFIG_PINCTRL=y
CONFIG_PINCTRL_IMX6=y
CONFIG_DM_REGULATOR=y
CONFIG_SPI=y
CONFIG_DM_SPI=y
CONFIG_FSL_QSPI=y
CONFIG_AUTOBOOT_KEYED=y
CONFIG_AUTOBOOT_PROMPT="Press . to abort autoboot in %d seconds\n"
CONFIG_AUTOBOOT_STOP_STR="."
CONFIG_SYS_PROMPT="U-Boot > "
CONFIG_ZERO_BOOTDELAY_CHECK=y
CONFIG_PHY_SMSC=y
CONFIG_FEC_MXC=y
CONFIG_MII=y
CONFIG_SYS_I2C_SPEED=100000
CONFIG_SYS_I2C_MXC_I2C1=y
CONFIG_SYS_I2C_MXC_I2C2=y
CONFIG_SYS_I2C_MXC_I2C3=y
CONFIG_SYS_I2C_LEGACY=y
CONFIG_SPL_SYS_I2C_LEGACY=y
CONFIG_SYS_I2C_MXC=y
```

## recipes-bsp/u-boot/u-boot-himx0294/Kconfig
```kconfig
if TARGET_HIMX0294

config SYS_BOARD
	default "himx0294"

config SYS_VENDOR
	default "freescale"

config SYS_CONFIG_NAME
	default "himx0294"

endif
```

## recipes-bsp/u-boot/u-boot-himx0294/himx0294_defconfig
```kconfig
CONFIG_SYS_EXTRA_OPTIONS="IMX_CONFIG=board/freescale/himx0294/nitrogen6q.cfg,MX6Q,DDR_MB=1024"
CONFIG_ARM=y
CONFIG_TARGET_HIMX0294=y
```

## recipes-bsp/u-boot/u-boot-himx0294/himx0294_dvmon_defconfig
```kconfig
CONFIG_SYS_EXTRA_OPTIONS="IMX_CONFIG=board/freescale/himx0294/nitrogen6q.cfg,MX6Q,BOARD_IS_HIMX_DVMON"
CONFIG_ARM=y
CONFIG_ARCH_MX6=y
CONFIG_TARGET_HIMX0294=y
CONFIG_DISPLAY_CPUINFO=y
CONFIG_DISPLAY_BOARDINFO=y
CONFIG_MMC=y
CONFIG_DEFAULT_FDT_FILE="/boot/imx6q-himx0294-dvmon.dtb"
CONFIG_AUTOBOOT_KEYED=y
CONFIG_AUTOBOOT_STOP_STR="."
CONFIG_BOOTDELAY=0
CONFIG_AUTOBOOT_PROMPT="Press . to abort autoboot in %d seconds\n"
CONFIG_VIDEO=y
CONFIG_CFB_CONSOLE=y
CONFIG_VGA_AS_SINGLE_DEVICE=y
CONFIG_SYS_CONSOLE_BG_COL=0x00
CONFIG_SYS_CONSOLE_FG_COL=0xa0
CONFIG_CONSOLE_MUX=y
CONFIG_SYS_CONSOLE_IS_IN_ENV=y
CONFIG_OF_LIBFDT=y
CONFIG_CMD_FUSE=y
CONFIG_CMD_MMC=y
CONFIG_ENV_IS_IN_MMC=y
```

## recipes-bsp/u-boot/u-boot-himx0294/himx0294_imoc_defconfig
```kconfig
CONFIG_SYS_EXTRA_OPTIONS="IMX_CONFIG=board/freescale/himx0294/nitrogen6q.cfg,MX6Q,BOARD_IS_HIMX_IMOC"
CONFIG_ARM=y
CONFIG_TARGET_HIMX0294=y
```

## recipes-bsp/u-boot/u-boot-himx0294/himx0294_ipcam_defconfig
```kconfig
CONFIG_SYS_EXTRA_OPTIONS="IMX_CONFIG=board/freescale/himx0294/imximage_scm_lpddr2.cfg,MX6Q,DDR_MB=1024,INTERLEAVING_MODE,BOARD_IS_HIMX_IPCAM"
CONFIG_ARM=y
CONFIG_ARCH_MX6=y
CONFIG_TARGET_HIMX0294=y
CONFIG_DISPLAY_CPUINFO=y
CONFIG_DISPLAY_BOARDINFO=y
CONFIG_MMC=y
CONFIG_DEFAULT_FDT_FILE="/boot/imx6qscm-himx0294-ipcam.dtb"
CONFIG_AUTOBOOT_KEYED=y
CONFIG_AUTOBOOT_STOP_STR="."
CONFIG_BOOTDELAY=0
CONFIG_AUTOBOOT_PROMPT="Press . to abort autoboot in %d seconds\n"
CONFIG_VIDEO=y
CONFIG_CFB_CONSOLE=y
CONFIG_VGA_AS_SINGLE_DEVICE=y
CONFIG_SYS_CONSOLE_BG_COL=0x00
CONFIG_SYS_CONSOLE_FG_COL=0xa0
CONFIG_CONSOLE_MUX=y
CONFIG_SYS_CONSOLE_IS_IN_ENV=y
CONFIG_OF_LIBFDT=y
CONFIG_CMD_FUSE=y
CONFIG_CMD_MMC=y
CONFIG_CMD_GPIO=y
CONFIG_CMD_SF=y
CONFIG_CMD_I2C=y
CONFIG_CMD_EXT2=y
CONFIG_CMD_EXT4=y
CONFIG_CMD_EXT4_WRITE=y
CONFIG_CMD_PING=y
CONFIG_CMD_DHCP=y
CONFIG_CMD_MII=y
CONFIG_CMD_HDMIDETECT=y
CONFIG_CMD_BOOTZ=y
CONFIG_CMD_BMP=y
CONFIG_CMD_TIME=y
CONFIG_CMD_MEMTEST=y
CONFIG_CMD_FS_GENERIC=y
CONFIG_ENV_IS_IN_MMC=y
```

## recipes-bsp/u-boot/u-boot-himx0294/himx0294_ivap_defconfig
```kconfig
CONFIG_SYS_EXTRA_OPTIONS="IMX_CONFIG=board/freescale/himx0294/nitrogen6q2g.cfg,MX6Q,DDR_MB=2048,BOARD_IS_HIMX_IVAP"
CONFIG_ARM=y
CONFIG_ARCH_MX6=y
CONFIG_TARGET_HIMX0294=y
CONFIG_AUTOBOOT_KEYED=y
CONFIG_AUTOBOOT_PROMPT="Press . to abort autoboot in %d seconds.\n"
CONFIG_AUTOBOOT_STOP_STR="."
```

## recipes-bsp/u-boot/u-boot-himx0294/himx0294_ivqp_defconfig
```kconfig
CONFIG_SYS_EXTRA_OPTIONS="IMX_CONFIG=board/freescale/mx6qsabreauto/mx6qp.cfg,MX6Q,BOARD_IS_HIMX_IVAP"
CONFIG_ARM=y
CONFIG_ARCH_MX6=y
CONFIG_TARGET_HIMX0294=y
```

## recipes-bsp/u-boot/u-boot-himx0294/himx0317_defconfig
```kconfig
CONFIG_SYS_EXTRA_OPTIONS="IMX_CONFIG=board/freescale/himx0294/nitrogen6q2g.cfg,MX6Q,DDR_MB=2048"
CONFIG_ARM=y
CONFIG_TARGET_HIMX0294=y
```

## recipes-bsp/u-boot/u-boot-kirkwood/hikirk_defconfig
```kconfig
CONFIG_SYS_EXTRA_OPTIONS="BOARD_IS_HIKIRK"
CONFIG_ARM=y
CONFIG_KIRKWOOD=y
CONFIG_TARGET_HIKIRK=y
CONFIG_SYS_NO_FLASH=y
CONFIG_SYS_MVFS=y
CONFIG_CMD_DHCP=y
CONFIG_CMD_ENV=y
CONFIG_CMD_MII=y
CONFIG_CMD_SPI=y
CONFIG_CMD_SF=y
CONFIG_CMD_PING=y
CONFIG_CMD_USB=y
CONFIG_CMD_IDE=y
CONFIG_CMD_EXT4=y
CONFIG_AUTOBOOT_KEYED=y
CONFIG_AUTOBOOT_PROMPT="Press . to abort autoboot in %d seconds.\n"
CONFIG_AUTOBOOT_STOP_STR="."
CONFIG_SPI_FLASH=y
CONFIG_SPI_FLASH_MTD=y
CONFIG_CMD_BDI=y
CONFIG_CMD_CONSOLE=y
CONFIG_CMD_BOOTD=y
CONFIG_CMD_RUN=y
CONFIG_CMD_IMI=y
CONFIG_CMD_XIMG=y
CONFIG_CMD_EDITENV=y
CONFIG_CMD_SAVEENV=y
CONFIG_CMD_MEMORY=y
CONFIG_CMD_LOADB=y
CONFIG_CMD_LOADS=y
CONFIG_CMD_ECHO=y
CONFIG_CMD_ITEST=y
CONFIG_CMD_SOURCE=y
CONFIG_CMD_NET=y
CONFIG_CMD_NFS=y
CONFIG_CMD_MISC=y
CONFIG_NET=y
# CONFIG_NET_RANDOM_ETHADDR is not set
# CONFIG_NETDEVICES is not set
# CONFIG_CMD_ENV_EXISTS is not set
# CONFIG_CMD_FLASH is not set
# CONFIG_CMD_FPGA is not set
# CONFIG_CMD_IMLS is not set
# CONFIG_CMD_NAND is not set
# CONFIG_CMD_SETEXPR is not set
# CONFIG_EXPERT is not set
CONFIG_SYS_NS16550=y
```
