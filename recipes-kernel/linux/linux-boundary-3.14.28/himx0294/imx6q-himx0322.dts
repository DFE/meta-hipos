/*
 * Copyright 2015 DResearch Fahrzeugelektronik GmbH
 * Copyright 2013 Boundary Devices
 * Copyright 2012 Freescale Semiconductor, Inc.
 * Copyright 2011 Linaro Ltd.
 *
 * The code contained herein is licensed under the GNU General Public
 * License. You may obtain a copy of the GNU General Public License
 * Version 2 or later at the following locations:
 *
 * http://www.opensource.org/licenses/gpl-license.html
 * http://www.gnu.org/copyleft/gpl.html
 */

/dts-v1/;

#include <dt-bindings/interrupt-controller/irq.h>
#include "imx6q.dtsi"
#include "imx6qdl-himx0322.dtsi"

/ {
	model = "dfe,himx0294-dvmon";
	compatible = "dfe,himx0322", "fsl,imx6q";
};

&mxcfb1 {
	status = "okay";
};

